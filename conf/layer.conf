## conf/layer.conf
```bitbake
# We have a conf and classes directory, add to BBPATH
BBPATH .= ":${LAYERDIR}"

# We have a recipes-* directories, add to BBFILES
BBFILES += "${LAYERDIR}/recipes-*/*/*.bb \
	${LAYERDIR}/recipes-*/*/*.bbappend"

BBFILE_COLLECTIONS += "myrpi2"
BBFILE_PATTERN_myrpi2 = "^${LAYERDIR}/"
BBFILE_PRIORITY_myrpi2 = "6"
```

## conf/machine/include/rpi-base.inc
```bitbake
require rpi-default-providers.inc
require rpi-default-versions.inc
require rpi-default-settings.inc 

XSERVER ?= "xserver-xorg \
           xf86-input-evdev \
           xf86-input-mouse \
           xf86-input-keyboard \
           ${@bb.utils.contains("MACHINE_FEATURES", "vc4graphics", "xf86-video-modesetting", "xf86-video-fbdev", d)} \
           "

MACHINE_EXTRA_RRECOMMENDS = " kernel-modules kernel-devicetree"

EXTRA_IMAGEDEPENDS += "u-boot"

IMAGE_FSTYPES += "tar.bz2"

SERIAL_CONSOLES = "115200;ttyAMA0"

KERNEL_IMAGETYPE = "zImage"
KERNEL_DEVICETREE = "bcm2709-rpi-2-b.dtb \
                    "

UBOOT_SUFFIX = "bin"

# Raspberry Pi has no hardware clock
MACHINE_FEATURES_BACKFILL_CONSIDERED = "rtc"

MACHINE_FEATURES = "apm keyboard usbhost vfat alsa"

IMAGE_BOOT_FILES ?= "u-boot.${UBOOT_SUFFIX}"
```

## conf/machine/myrpi2.conf
```bitbake
#@TYPE: Machine
#@NAME: myrpi2

#@DESCRIPTION: Machine configuration for myrpi2 systems

DEFAULTTUNE ?= "cortexa7thf-neon-vfpv4"
require conf/machine/include/tune-cortexa7.inc
require conf/machine/include/rpi-base.inc

UBOOT_MACHINE = "rpi_2_defconfig"
```
